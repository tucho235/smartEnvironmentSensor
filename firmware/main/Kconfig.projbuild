## firmware/main/Kconfig.projbuild
```kconfig
menu "Smart Environment Sensor Configuration"

    choice APP_SENSOR_MODEL
        prompt "Environmental sensor model"
        default APP_SENSOR_BME680
        help
            Selects the I2C sensor driver, MQTT measurement set and default
            Matter measurement clusters included in this firmware build.

        config APP_SENSOR_BME680
            bool "Bosch BME680"

        config APP_SENSOR_SHT30
            bool "Sensirion SHT30"
    endchoice

    config APP_SHT30_I2C_ADDRESS
        hex "SHT30 I2C address"
        default 0x44
        range 0x44 0x45
        depends on APP_SENSOR_SHT30
        help
            Select 0x44 when ADDR is low or left at the breakout default, and
            0x45 when ADDR is tied high.

    config APP_ENABLE_MATTER
        bool "Enable Matter endpoint integration"
        default n
        help
            Enables the ESP-Matter dependency and starts the Matter node with
            the standard measurement clusters supported by the selected sensor.
            BME680 exposes temperature, humidity and pressure; SHT30 exposes
            temperature and humidity. Keep disabled while developing or testing
            MQTT-only firmware.

    config APP_MATTER_UPDATE_INTERVAL_MS
        int "Matter sensor update interval in milliseconds"
        default 5000
        range 1000 3600000
        depends on APP_ENABLE_MATTER
        help
            Interval used by the Matter update task to mirror the latest
            sensor_service snapshot into Matter measurement attributes. This is
            independent from the sensor sampling interval and MQTT publish
            interval.

    config APP_MATTER_ENABLE_POWER_SOURCE
        bool "Expose Matter PowerSource endpoint"
        default y
        depends on APP_ENABLE_MATTER
        help
            Exposes a static USB PowerSource endpoint. Disable this for strict
            environmental-sensor validation builds.

    config APP_MATTER_THERMOSTAT_ONLY
        bool "Expose only a Matter Thermostat endpoint"
        default n
        depends on APP_ENABLE_MATTER
        help
            Creates only endpoint 1 as a standard Matter Thermostat with the
            Thermostat cluster LocalTemperature attribute. This mirrors the
            Espressif low-code thermostat product shape for SmartThings
            controller validation.

    config APP_MATTER_TEMPERATURE_ONLY
        bool "Expose only a Matter Temperature Sensor endpoint"
        default n
        depends on APP_ENABLE_MATTER
        depends on !APP_MATTER_THERMOSTAT_ONLY
        help
            Creates only endpoint 1 as a standard Matter Temperature Sensor
            with the TemperatureMeasurement cluster.

    config APP_MATTER_SEPARATE_SENSOR_ENDPOINTS
        bool "Expose Matter sensors on separate endpoints"
        default n
        depends on APP_ENABLE_MATTER
        depends on !APP_MATTER_THERMOSTAT_ONLY
        depends on !APP_MATTER_TEMPERATURE_ONLY
        help
            Exposes each measurement supported by the selected sensor as a
            separate standard Matter sensor endpoint. This follows Espressif's
            single-sensor product shape and is useful for controller portability
            validation.

    config APP_ENABLE_MQTT_TELEMETRY
        bool "Enable MQTT telemetry"
        default y
        help
            Enables the ESP-MQTT telemetry client and MQTT configuration
            provisioning endpoints. Disable this for Matter-only validation
            builds.

    config APP_ENABLE_CONFIG_PORTAL
        bool "Enable local HTTP configuration portal"
        default y
        depends on APP_ENABLE_MQTT_TELEMETRY
        help
            Enables the local HTTP configuration portal. The current portal
            exposes MQTT configuration and Matter runtime settings, so it is
            compiled with the MQTT configuration layer.

    config APP_WIFI_PROV_SERVICE_PREFIX
        string "BLE provisioning service name prefix"
        default "SMENV_"
        help
            Prefix used to build the BLE device name shown by the provisioning
            app. The last three bytes of the Wi-Fi MAC are appended.

    config APP_WIFI_PROV_POP
        string "BLE provisioning proof of possession"
        default ""
        help
            Optional local proof of possession for provisioning security 1.
            Leave empty for initial development. If set, keep it only in the
            ignored local sdkconfig file and do not add it to sdkconfig.defaults.

    config APP_WIFI_PROV_MAX_ATTEMPTS
        int "Maximum provisioning Wi-Fi connection attempts"
        default 5
        range 1 20
        help
            Number of connection attempts the provisioning manager may use when
            testing newly received Wi-Fi credentials.

    config APP_MQTT_BROKER_URI
        string "MQTT broker URI bootstrap"
        default ""
        depends on APP_ENABLE_MQTT_TELEMETRY
        help
            Optional bootstrap MQTT broker URI, for example
            mqtt://192.168.3.10:1883. If MQTT configuration is not present in
            NVS, the firmware seeds NVS from this local sdkconfig value. Leave
            empty for BLE/runtime-only configuration.

    config APP_MQTT_USERNAME
        string "MQTT username bootstrap"
        default ""
        depends on APP_ENABLE_MQTT_TELEMETRY
        help
            Optional bootstrap MQTT username. This value is written to the local
            sdkconfig file, which is ignored by Git. Do not add credentials to
            sdkconfig.defaults.

    config APP_MQTT_PASSWORD
        string "MQTT password bootstrap"
        default ""
        depends on APP_ENABLE_MQTT_TELEMETRY
        help
            Optional bootstrap MQTT password. This value is written to the local
            sdkconfig file, which is ignored by Git. Do not add credentials to
            sdkconfig.defaults.

    config APP_MQTT_TELEMETRY_TOPIC
        string "Default MQTT telemetry topic"
        default "smart-environment-sensor/sht30/state" if APP_SENSOR_SHT30
        default "smart-environment-sensor/bme680/state"
        depends on APP_ENABLE_MQTT_TELEMETRY
        help
            Initial topic used for periodic sensor telemetry snapshots. The
            value remains editable in the HTML portal and is persisted in NVS.

    config APP_MQTT_PUBLISH_INTERVAL_MS
        int "MQTT telemetry publish interval in milliseconds"
        default 10000
        range 1000 3600000
        depends on APP_ENABLE_MQTT_TELEMETRY
        help
            Interval used by the MQTT telemetry task. This is independent from
            the sensor sampling interval.

    config APP_MQTT_RECONNECT_INTERVAL_MS
        int "MQTT broker reconnect interval in milliseconds"
        default 10000
        range 1000 3600000
        depends on APP_ENABLE_MQTT_TELEMETRY
        help
            Broker reconnect interval used by the ESP-MQTT client.

endmenu
```

## firmware/sdkconfig.defaults
```kconfig
CONFIG_IDF_TARGET="esp32c3"
CONFIG_LOG_DEFAULT_LEVEL_INFO=y
CONFIG_ESPTOOLPY_FLASHSIZE_4MB=y
CONFIG_ESPTOOLPY_FLASHSIZE="4MB"
CONFIG_PARTITION_TABLE_CUSTOM=y
CONFIG_PARTITION_TABLE_CUSTOM_FILENAME="partitions.csv"
CONFIG_PARTITION_TABLE_FILENAME="partitions.csv"
CONFIG_BT_ENABLED=y
CONFIG_BT_NIMBLE_ENABLED=y
CONFIG_ESP_PROTOCOMM_SUPPORT_SECURITY_VERSION_1=y
```
